## nemagfx/Kconfig
```kconfig
#
# Copyright (c) 2022 Nordic Semiconductor
#
# SPDX-License-Identifier: LicenseRef-Nordic-5-Clause
#

menuconfig NEMA
	bool "Nema graphics subsystem"
	help
	  Nema graphics subsystem.

if NEMA

module = NEMA
module-str = nema
source "subsys/logging/Kconfig.template.log_config"

choice NEMA_SOURCE
	prompt "Nema origin"
	default NEMA_SOURCE_NRFXLIB
	help
	  Select the origin of the library.

config NEMA_SOURCE_NRFXLIB
	bool "nrfxlib"

endchoice # NEMA_SOURCE

choice NEMA_PLATFORM_CHOICE
	prompt "Nema platform"
	default NEMA_PLATFORM_ZEPHYR_POSIX if BOARD_NATIVE_POSIX
	default NEMA_PLATFORM_ZEPHYR_NRF if BOARD_NRF7140DK_NRF7140_CPUAPP

config NEMA_PLATFORM_ZEPHYR_POSIX
	bool "Native POSIX platform with SDL"
	depends on BOARD_NATIVE_POSIX
	select HAS_SDL
	help
	  Native POSIX Nema platform.

config NEMA_PLATFORM_ZEPHYR_NRF
	bool "nRF SoC"
	help
	  nRF SoCs with integrated GPU and display controller.

endchoice

config NEMA_PLATFORM
	string
	default "zephyr_posix" if NEMA_PLATFORM_ZEPHYR_POSIX
	default "zephyr_nrf" if NEMA_PLATFORM_ZEPHYR_NRF
	help
	  String name of the target platform.

config APP_LINK_WITH_NEMA
	bool "Link 'app' with the Nema libraries"
	default y
	help
	  Add Nema libraries header files to the 'app' include path.

config NEMADC_ENABLE
	bool "Nema Display Controller library"
	default y
	help
	  Use NEMA-DC-400 built in display controller library.

config NEMAVG_ENABLE
	bool "Nema Vector Graphics library"
	depends on NEMA_PLATFORM_ZEPHYR_NRF
	help
	  Enable Nema Vector Graphics library.

config NEMAGUI_ENABLE
	bool "Nema GUI library"
	help
	  Enable Nema GUI library.

endif # NEMA
```

## nrf_802154/internal/zephyr/Kconfig.nrfxlib
```kconfig
#
# Copyright (c) 2023, Nordic Semiconductor ASA. All Rights Reserved.
#
# The information contained herein is confidential property of Nordic Semiconductor ASA.
# The use, copying, transfer or disclosure of such information is prohibited except by
# express written agreement with Nordic Semiconductor ASA.
#

if NRF_802154_SL

config NRF_802154_SL_LPTIMER_GRTC
	def_bool y
	depends on SOC_PLATFORM_HALTIUM || SOC_PLATFORM_NRF54L

config NRF_802154_SL_LPTIMER_EVENTS_HALTIUM
	def_bool y
	depends on NRF_802154_SL_LPTIMER_GRTC
	depends on SOC_PLATFORM_HALTIUM

config NRF_802154_SL_LPTIMER_EVENTS_NRF54L
	def_bool y
	depends on NRF_802154_SL_LPTIMER_GRTC
	depends on SOC_PLATFORM_NRF54L

endif # NRF_802154_SL
```
